## conf/machine/iesy-imx93-eva-mi.conf
```bitbake
require conf/machine/imx93-11x11-lpddr4x-evk.conf

MACHINE_NAME = "iesy i.MX93 EVA-MI (Eval Kit)"

COMPATIBLE_MACHINE:iesy-imx93-eva-mi = "iesy-imx93-eva-mi"

UBOOT_DTB_NAME = "iesy-imx93-eva-mi.dtb"
UBOOT_CONFIG_BASENAME = "iesy_imx93_eva_mi"

KERNEL_DEVICETREE = "\
	iesy/iesy-imx93-eva-mi-v1.dtb \
	"

BBMASK += " \
	.linux-rockchip.*.bbappend \
	.u-boot-rockchip.*.bbappend \
	.*linux-ti.*.bbappend \
	.*u-boot-ti.*.bbappend \
	"

MACHINE_FEATURES:append = " nxp9098-sdio"

KERNEL_MODULE_AUTOLOAD += "moal"
KERNEL_MODULE_PROBECONF += "moal"
module_conf_moal = "options moal mod_para=nxp/wifi_mod_para.conf"
```
