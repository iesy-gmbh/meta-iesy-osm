## conf/distro/iesy-base.conf
```bitbake
# iesy Base Distribution

require conf/distro/poky.conf

DISTRO = "iesy-base"
DISTRO_NAME = "iesy Base Distribution"
DISTRO_VERSION = ""

MAINTAINER = "Stefan Lellwitz <lel@iesy.com>"

TARGET_VENDOR = "-iesy"

# make sure to support both
DISTRO_FEATURES += "sysvinit systemd"

# let image recipes decide which init system to use
VIRTUAL-RUNTIME_init_manager ?= ""
VIRTUAL-RUNTIME_initscripts ?= ""
VIRTUAL-RUNTIME_login_manager ?= ""
```

## conf/distro/iesy-default.inc
```bitbake
require conf/distro/poky.conf

MAINTAINER = "Stefan Lellwitz <lel@iesy.com>"

TARGET_VENDOR = "-iesy"
```

## conf/distro/iesy-fb.conf
```bitbake
# iesy minimal console-only (Framebuffer) Distribution

require conf/distro/iesy-default.inc

DISTRO = "iesy-fb"
DISTRO_NAME = "iesy Minimal Distribution"
DISTRO_VERSION = ""

# use neither systemd nor sysvinit
DISTRO_FEATURES_BACKFILL_CONSIDERED = "systemd sysvinit"

# use neither wayland nor x11
DISTRO_FEATURES:remove = "wayland x11"

# use mdev/busybox for init
VIRTUAL-RUNTIME_dev_manager = "busybox-mdev"
VIRTUAL-RUNTIME_init_manager = "busybox"
VIRTUAL-RUNTIME_initscripts = "initscripts"
VIRTUAL-RUNTIME_login_manager = "busybox"
```

## conf/distro/iesy-wayland.conf
```bitbake
# iesy Distribution supporting Wayland and XWayland

require conf/distro/iesy-default.inc

DISTRO = "iesy-wayland"
DISTRO_NAME = "iesy Wayland (XWayland) Distribution"
DISTRO_VERSION = ""

# use systemd exclusively
DISTRO_FEATURES_BACKFILL_CONSIDERED = "sysvinit"

DISTRO_FEATURES += "systemd wayland x11"

# use systemd for system initialization
VIRTUAL-RUNTIME_init_manager = "systemd"
VIRTUAL-RUNTIME_initscripts = "systemd-compat-units"

VIRTUAL-RUNTIME_login_manager = "shadow-base"

# use full-featured set of packages instead of busybox for base utils
PREFERRED_PROVIDER_virtual/base-utils = "packagegroup-core-base-utils"
VIRTUAL-RUNTIME_base-utils = "packagegroup-core-base-utils"
VIRTUAL-RUNTIME_base-utils-hwclock = "util-linux-hwclock"
VIRTUAL-RUNTIME_base-utils-syslog=""
```

## conf/distro/iesy-x11.conf
```bitbake
# iesy Distribution with native X11 support

require conf/distro/iesy-default.inc

DISTRO = "iesy-x11"
DISTRO_NAME = "iesy X11 Distribution"
DISTRO_VERSION = ""

# use sysvinit exclusively
DISTRO_FEATURES_BACKFILL_CONSIDERED = "systemd"

# do not use wayland
DISTRO_FEATURES:remove = "wayland"

DISTRO_FEATURES += "sysvinit x11"

# use sysvinit for system initialization
VIRTUAL-RUNTIME_init_manager = "sysvinit"
VIRTUAL-RUNTIME_initscripts = "initscripts"

VIRTUAL-RUNTIME_login_manager = "shadow-base"

# use full-featured set of packages instead of busybox for base utils
PREFERRED_PROVIDER_virtual/base-utils = "packagegroup-core-base-utils"
VIRTUAL-RUNTIME_base-utils = "packagegroup-core-base-utils"
VIRTUAL-RUNTIME_base-utils-hwclock = "util-linux-hwclock"
VIRTUAL-RUNTIME_base-utils-syslog=""
```

## conf/layer.conf
```bitbake
# We have a conf and classes directory, add to BBPATH
BBPATH .= ":${LAYERDIR}"

# We have recipes-* directories, add to BBFILES
BBFILES += "${LAYERDIR}/recipes-*/*/*.bb \
            ${LAYERDIR}/recipes-*/*/*.bbappend"

BBFILE_COLLECTIONS += "meta-iesy-osm"
BBFILE_PATTERN_meta-iesy-osm = "^${LAYERDIR}/"
BBFILE_PRIORITY_meta-iesy-osm = "10"

LAYERDEPENDS_meta-iesy-osm = "core"
LAYERSERIES_COMPAT_meta-iesy-osm = "dunfell"
```

## conf/machine/iesy-am62xx-eva-mi-k3r5.conf
```bitbake
require conf/machine/am62xx-evm-k3r5.conf

BBMASK += " \
    .*fslc.*.bbappend \
    .*imx.*.bbappend \
    .*rockchip.*.bbappend \
    .*tinycompress.*.bbappend \
	"

UBOOT_MACHINE = "iesy_am62xx_eva_mi_r5_defconfig"
```

## conf/machine/iesy-am62xx-eva-mi.conf
```bitbake
require conf/machine/am62xx-evm.conf

MACHINE_NAME = "iesy AM62XX OSM-LF (Eval Kit)"

BBMASK += " \
    .*fslc.*.bbappend \
    .*imx.*.bbappend \
    .*rockchip.*.bbappend \
    .*tinycompress.*.bbappend \
	"

# UBOOT_MACHINE = "iesy_am62xx_eva_mi_a53_defconfig"

KERNEL_DEVICETREE_PREFIX = " \
    ti/iesy-am62xx-eva-mi \
"

KERNEL_DEVICETREE = " \
    ti/iesy-am62xx-eva-mi.dtb \
"

IMAGE_FSTYPES += "wic.gz"
```

## conf/machine/iesy-imx8m-eva-mi.conf
```bitbake
require conf/machine/imx8mmevk.conf

MACHINE_NAME = "iesy i.MX8M EVA-MI Eval Kit"
```

## conf/machine/iesy-imx8mm-eva-mi.conf
```bitbake
require conf/machine/imx8mm-lpddr4-evk.conf

MACHINE_NAME = "iesy i.MX8M Mini OSM-SF (Eval Kit)"

COMPATIBLE_MACHINE:iesy-imx8mm-eva-mi = "iesy-imx8mm-eva-mi"

IMX_DEFAULT_BOOTLOADER = "u-boot-imx"

PREFERRED_PROVIDER_imx-atf ??= "imx-atf"
PREFERRED_PROVIDER_virtual/kernel = "linux-fslc-imx"

KERNEL_DEVICETREE = "\
	iesy/iesy-imx8mm-eva-mi.dtb \
	"

BBMASK += " \
	.linux-rockchip.*.bbappend \
	.u-boot-rockchip.*.bbappend \
	"

MACHINE_FEATURES:append = " nxp9098-sdio"

KERNEL_MODULE_AUTOLOAD += "moal"
KERNEL_MODULE_PROBECONF += "moal"
module_conf_moal = "options moal mod_para=nxp/wifi_mod_para.conf"

# fix vim / vim-tiny build error on XWayland
PACKAGECONFIG:remove_pn-vim = "${@bb.utils.contains('DISTRO_FEATURES', 'wayland x11', 'x11', '', d)}"
PACKAGECONFIG:remove_pn-vim-tiny = "${@bb.utils.contains('DISTRO_FEATURES', 'wayland x11', 'x11', '', d)}"

SERIAL_CONSOLES = "115200;ttymxc2"
ATF_BOOT_UART_BASE = "0x30880000"
```

## conf/machine/iesy-rpx30-eva-mi-v2.conf
```bitbake
require conf/machine/rockchip-px30-evb.conf

MACHINE_NAME = "iesy RPX30 EVA-MI V2.xx (Eval Kit)"

KERNEL_DEVICETREE = "iesy/iesy-rpx30-eva-mi-v2.dtb"
UBOOT_MACHINE = "iesy_rpx30_eva_mi_defconfig"

BBMASK += " \
	.imx-gpu-viv.*.bbappend \
	.xf86-video-imx-vivante.*.bbappend \
	.*imx.*.bbappend \
	.*fslc.*.bbappend \
	.*tinycompress.*.bbappend \
	.*linux-ti.*.bbappend \
	.*u-boot-ti.*.bbappend \
	"

#IMAGE_FSTYPES:remove = "wic"
IMAGE_FSTYPES += "wic.gz"

XSERVER = "xserver-xorg xf86-video-modesetting"

# Prefer using Rockchip BSP kernel 4.19
#PREFERRED_VERSION_linux-rockchip = "4.19%"
#LINUXLIBCVERSION = "4.19-custom%"
ATF_PLAT = "px30"
PREFERRED_PROVIDER_virtual/bootloader = "u-boot-mainline"

# Prefer using Rockchip BSP kernel 5.10
PREFERRED_VERSION_linux-rockchip = "5.10%"
LINUXLIBCVERSION = "5.10-custom%"

WKS_FILE = "rockchip-gptdisk.wks.in"

IMAGE_BOOT_FILES = "Image iesy-rpx30-eva-mi-v2.dtb"
```

## conf/machine/iesy-rpx30-eva-mi.conf
```bitbake
require conf/machine/rockchip-px30-evb.conf

MACHINE_NAME = "iesy RPX30 EVA-MI (Eval Kit)"

KERNEL_DEVICETREE = "iesy/iesy-rpx30-eva-mi.dtb"

BBMASK += " \
	.imx-gpu-viv.*.bbappend \
	.xf86-video-imx-vivante.*.bbappend \
	.*imx.*.bbappend \
	.*fslc.*.bbappend \
	.*tinycompress.*.bbappend \
	.*linux-ti.*.bbappend \
	"

IMAGE_FSTYPES:remove = "wic"
IMAGE_FSTYPES += "wic.gz"

XSERVER = "xserver-xorg xf86-video-modesetting"

# Prefer using Rockchip BSP kernel 4.19
#PREFERRED_VERSION_linux-rockchip = "4.19%"
#LINUXLIBCVERSION = "4.19-custom%"

# Prefer using Rockchip BSP kernel 5.10
PREFERRED_VERSION_linux-rockchip = "5.10%"
LINUXLIBCVERSION = "5.10-custom%"
```
